## base_external/package/customdriver/Config.in
```kconfig
config BR2_PACKAGE_CUSTOMDRIVER
	bool "customdriver"
	help
	  Includes the modules for assignment 8 in kernel image
```

## base_external/package/ldd/Config.in
```kconfig
config BR2_PACKAGE_LDD
	bool "ldd"
	help
	  Includes the modules for assignment 7 in kernel image
```
